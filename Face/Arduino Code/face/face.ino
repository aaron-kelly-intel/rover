// include the library code:
#include <LiquidCrystal.h>

#define MAINROW 4
#define MAINCOL 6
#define SUBROW 8
#define SUBCOL 5




boolean face[] = {
0,0,0,0,0,0,0,0,0,0,0,0,0,0,1,1,1,1,1,1,1,1,0,0,0,0,0,0,0,0,0,0,0,0,0,
0,0,0,0,0,0,0,0,0,0,0,1,1,1,1,1,1,1,1,1,1,1,1,1,1,0,0,0,0,0,0,0,0,0,0,
0,0,0,0,0,0,0,0,0,1,1,1,1,1,0,0,0,0,0,0,0,0,1,1,1,1,0,0,0,0,0,0,0,0,0,
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0,0,0,0,0,0,0,0,0,0,0,0,0,0,1,1,1,1,1,1,1,0,0,0,0,0,0,0,0,0,0,0,0,0,0
};
int count = 2;
// initialize the library with the numbers of the interface pins
LiquidCrystal lcd(4, 6, 2, 3, 5, 7);

byte imageByteArray[MAINROW][MAINCOL][SUBROW];
int Byte = 0;

void setup()
{
  Serial.begin(9600);
  //while (!Serial);

  lcd.begin(16, 4);
  lcd.clear();

  readPicture();
}

void loop()
{
  displayPicture(5);
}


int readPicture()
{
  int index = 0;
  for (int g = 0; g < MAINROW; g++) // 4 rows of 5x8
  {
    for (int r = 0; r < SUBROW; r++) // 8 rows of 5x1
    {
      for (int i = 0; i < MAINCOL; i++) // 4 columns of 5x1
      {
        Byte = 0;
        for (int k = SUBCOL - 1; k >= 0; k--) // 5 bits per row
        {
          Byte += (face[index] * pow(2, k));
          index++;
        }
        imageByteArray[g][i][r] = Byte;
        if (i != MAINCOL - 1) // for each main column apart from the last one
        {
          index++; // jump one to account for the pixel missing on the screen
        }
      }
    }
    index += 35;  //skip an entire line to account for missing pixels
  }
}


int  displayPicture(int dist)
{
  for (int g = 0; g < MAINROW; g++) // 4 rows of 5x8
  {
    for (int i = 0; i < MAINCOL; i++) // 4 columns of 5x1
    {
      if(count >= 8)
      {
        count = 0;
        delay(20);
        lcd.clear();
      }
      lcd.createChar(byte(count), imageByteArray[g][i]);
      lcd.setCursor(i + dist, g);
      //lcd.write('a');
      lcd.write(byte(count));
      count++;
    }
  }
}

