// include the library code:
#include <LiquidCrystal.h>

#define MAINROW 4
#define MAINCOL 6
#define SUBROW 8   // don't change
#define SUBCOL 5   // don't change

#define interUnimpressedPin 2
#define interPerseveringPin 3

boolean faceCoolDude[] = {
0,0,0,0,0,0,0,0,0,0,0,0,0,0,1,1,1,1,1,1,1,1,0,0,0,0,0,0,0,0,0,0,0,0,0,
0,0,0,0,0,0,0,0,0,0,0,1,1,1,1,1,1,1,1,1,1,1,1,1,1,0,0,0,0,0,0,0,0,0,0,
0,0,0,0,0,0,0,0,0,1,1,1,1,1,0,0,0,0,0,0,0,0,1,1,1,1,0,0,0,0,0,0,0,0,0,
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0,0,0,0,0,0,0,0,0,0,0,0,0,0,1,1,1,1,1,1,1,0,0,0,0,0,0,0,0,0,0,0,0,0,0
};

boolean faceUnimpressed[] = {
0,0,0,0,0,0,0,0,0,0,0,0,0,0,1,1,1,1,1,1,1,0,0,0,0,0,0,0,0,0,0,0,0,0,0,
0,0,0,0,0,0,0,0,0,0,0,1,1,1,1,1,1,1,1,1,1,1,1,1,0,0,0,0,0,0,0,0,0,0,0,
0,0,0,0,0,0,0,0,0,1,1,1,1,1,0,0,0,0,0,0,0,1,1,1,1,1,0,0,0,0,0,0,0,0,0,
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0,0,0,0,0,0,0,0,0,0,0,0,0,0,1,1,1,1,1,1,1,0,0,0,0,0,0,0,0,0,0,0,0,0,0
};

boolean facePersevering[] = {
0,0,0,0,0,0,0,0,0,0,0,0,0,0,1,1,1,1,1,1,1,0,0,0,0,0,0,0,0,0,0,0,0,0,0,
0,0,0,0,0,0,0,0,0,0,0,1,1,1,1,1,1,1,1,1,1,1,1,1,0,0,0,0,0,0,0,0,0,0,0,
0,0,0,0,0,0,0,0,0,1,1,1,1,1,0,0,0,0,0,0,0,1,1,1,1,1,0,0,0,0,0,0,0,0,0,
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0,0,0,0,0,0,0,0,0,0,0,0,0,0,1,1,1,1,1,1,1,0,0,0,0,0,0,0,0,0,0,0,0,0,0
};
           //    \/ (change the second number) off set of the refresh
int count = (8 - 6);  
// initialize the library with the numbers of the interface pins
LiquidCrystal lcd(6, 8, 4, 5, 7, 9);                                // ******** pins changed

byte imageByteArray[MAINROW][MAINCOL][SUBROW];
int Byte = 0;

void setup()
{
  Serial.begin(9600);
  //while (!Serial);

  lcd.begin(16, 4);
  lcd.clear();
  readPicture(faceUnimpressed);
  attachInterrupt(digitalPinToInterrupt(interUnimpressedPin), unimpressed, CHANGE);
  attachInterrupt(digitalPinToInterrupt(interPerseveringPin), persevering, CHANGE);
}

void loop()
{
  displayPicture(5);
}


int readPicture(boolean faceToLoad[1225])
{
  int index = 0;
  for (int g = 0; g < MAINROW; g++) // 4 rows of 5x8
  {
    for (int r = 0; r < SUBROW; r++) // 8 rows of 5x1
    {
      for (int i = 0; i < MAINCOL; i++) // 4 columns of 5x1
      {
        Byte = 0;
        for (int k = SUBCOL - 1; k >= 0; k--) // 5 bits per row
        {
          Byte += (faceToLoad[index] * pow(2, k));
          index++;
        }
        imageByteArray[g][i][r] = Byte;
        if (i != MAINCOL - 1) // for each main column apart from the last one
        {
          index++; // jump one to account for the pixel missing on the screen
        }
      }
    }
    index += 35;  //skip an entire line to account for missing pixels
  }
}


int  displayPicture(int dist)
{
  for (int g = 0; g < MAINROW; g++) // 4 rows of 5x8
  {
    for (int i = 0; i < MAINCOL; i++) // 4 columns of 5x1
    {
      if(count >= 8)
      {
        count = 0;
        delay(20);
        lcd.clear();
      }
      lcd.createChar(byte(count), imageByteArray[g][i]);
      lcd.setCursor(i + dist, g);
      //lcd.write('a');
      lcd.write(byte(count));
      count++;
    }
  }
}

void unimpressed()
{
  if(digitalRead(interUnimpressedPin) == HIGH)
  {
    readPicture(faceUnimpressed);
  }
  else
  {
    readPicture(faceCoolDude);
  }
}

void persevering()
{
  if(digitalRead(interPerseveringPin) == HIGH)
  {
    readPicture(facePersevering);
  }
  else
  {
    readPicture(faceCoolDude);
  }
}

